// [code]
// Calculus library
#include <Cache.h>
#include <Quadratic.h>
#include <TimeStep.h>

#include <math.h>

const double dt = 0.01;       // Timestep in sec
const byte cachesamples = 3;  // Samples in cache
const byte filtersamples = 3;
const byte masamples = 7;
const byte masamples1 = 9;
const byte masamples2 = 5;
const double init_c = 0.0;  // Initial value of cache
const double init_i = 0.0;  // Initial value of integrator

double pid_output;
double dist_m;
double f_deriv;
double filter_part, filter1_part;
double part0;
double part1, part11;
double part2, part12;
double acc_rate_limit = 3.3 * dt;  // rate limit of accelleration
double rate_limit = 0.4 * dt;      // Rate limitation of derivative (biker acceleration)
double rate_limit2 = 2 * dt;       // Max acceleration of treadmill approx 0.475m/ sˆ2
double f_deriv_prev, f_acc_prev;
double ma_deriv, ma_acc, ma_dist_m;
double f_acc;
double dist_m_prev;
bool Startready;
bool Stopready;

// PID constants
double Kp;
double Kd;
double Ka;

TimeStep ts(dt);
Cache cache(cachesamples, init_c);
Cache cache2(cachesamples, init_c);
Cache movingaverage(masamples, init_c);
Cache movingaverage1(masamples1, init_c);
Cache movingaverage2(masamples2, init_c);
Cache filter(filtersamples, init_c);
Cache filter2(filtersamples, init_c);
Quadratic quad;
Quadratic quad2;

// Libraries Lidar
#include <RF24.h>
#include <SPI.h>
#include <SoftwareSerial.h>
#include <Wire.h>
#include <nRF24L01.h>

// Define radio
RF24 radio(9, 10);  // CE, CSN
const byte address[6] = "00001";

int dist;
float input;
float Kmh;
float V_demand;

double y_deriv, y_acc;
double pid_out2;
double pid_output_prev;
double y_deriv_prev;
double pastdist;

float derivative;
float integration;
float proportional;
float acceleration;

unsigned long currentTime, previousTime1, previousTime2, previousTime3, previousTime4, previousTime5;
float minimumruntime = 15;     // minimum runtime for start stop system in sec ; default 10
float startstopinterval = 20;  // minimum time after which can be started after stopped in sec ; default 10
float minimumspeed = 4;        // minimum biker speed for start stop system
float setpoint;

///////////////
// Calibration:
///////////////

const byte PulsesPerRevolution = 4;  // Set how many pulses there are on each revolution. Default: 2.

const unsigned long ZeroTimeout = 1000000;
// Calibration for smoothing RPM:
const byte numReadings = 2;

/////////////
// Variables:
/////////////

volatile unsigned long LastTimeWeMeasured;                        // Stores the last time we measured a pulse so we can calculate the period.
volatile unsigned long PeriodBetweenPulses = ZeroTimeout + 1000;  // Stores the period between pulses in microseconds.
// It has a big number so it doesn’t start with 0 which would be interpreted as a high frequency.
volatile unsigned long PeriodAverage = ZeroTimeout + 1000;  // Stores the period between pulses in microseconds in total, if we are taking multiple pulses.
// It has a big number so it doesn’t start with 0 which would be interpreted as a high frequency.
unsigned long FrequencyRaw;     // Calculated frequency, based on the period. This has a lot of extra decimals without the decimal point.
unsigned long FrequencyReal;    // Frequency without decimals.
unsigned long RPM;              // Raw RPM without any processing.
unsigned int PulseCounter = 1;  // Counts the amount of pulse readings we took so we can average multiple pulses before calculating the period.

unsigned long PeriodSum;  // Stores the summation of all the periods to do the average.

unsigned long LastTimeCycleMeasure = LastTimeWeMeasured;
unsigned long CurrentMicros = micros();
unsigned int AmountOfReadings = 1;

unsigned int ZeroDebouncingExtra;

// Variables for smoothing tachometer:
unsigned long readings[numReadings];  // The input.
unsigned long readIndex;              // The index of the current reading.
unsigned long total;                  // The running total.
unsigned long average;                // The RPM value after applying the smoothing.

int speednr;
byte start[] = { 0xAC, 0x01, 0x0B, 0x00, 0x00, 0xE0, 0x26 };
byte stopcmd[] = { 0xAC, 0x01, 0x0C, 0x00, 0x00, 0x51, 0xE7 };
byte setspeed[196][19] = {
  { 0xAC, 0x01, 0x09, 0x00, 0x0C, 0x00, 0x00, 0x00, 0x00, 0x05, 0x00, 0x00, 0x00, 0x00, 0x00, 0x00, 0x00, 0x64, 0x44 },
  { 0xAC, 0x01, 0x09, 0x00, 0x0C, 0x00, 0x00, 0x00, 0x00, 0x06, 0x00, 0x00, 0x00, 0x00, 0x00, 0x00, 0x00, 0x24, 0x51 },
  { 0xAC, 0x01, 0x09, 0x00, 0x0C, 0x00, 0x00, 0x00, 0x00, 0x07, 0x00, 0x00, 0x00, 0x00, 0x00, 0x00, 0x00, 0xE5, 0x9D },
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  { 0xAC, 0x01, 0x09, 0x00, 0x0C, 0x00, 0x00, 0x00, 0x00, 0xC8, 0x00, 0x00, 0x00, 0x00, 0x00, 0x00, 0x00, 0xA9, 0x8D },
};

void setup()  // Start of setup:
{
  setpoint = 2.88;  // midpoint treadmill

  //----Speedsensor----//
  attachInterrupt(digitalPinToInterrupt(2), Pulse_Event, RISING);  // Enable interruption pin 2 when going from LOW to HIGH.

  //----Radio Lidar----//
  Serial.begin(115200);
  radio.begin();
  radio.openReadingPipe(0, address);
  radio.setPALevel(RF24_PA_MIN);
  radio.setDataRate(RF24_1MBPS);
  radio.startListening();

  //----Treadmill----//
  Serial1.begin(19200);
  // Serial1.write(start, sizeof(start)) ;

  dist_m = setpoint;

  // Initial values
  part1 = 0;
  part2 = 0;
  f_deriv_prev = 0;
  pid_output_prev = 0;
  Startready = true;
  Stopready = false;
}  // End of setup.

void loop()  // Start of loop:
{

  //----Speedsensor----//

  LastTimeCycleMeasure = LastTimeWeMeasured;  // Store the LastTimeWeMeasured in a variable.
  CurrentMicros = micros();                   // Store the micros() in a variable.

  if (CurrentMicros < LastTimeCycleMeasure) {
    LastTimeCycleMeasure = CurrentMicros;
  }

  FrequencyRaw = 10000000000 / PeriodAverage;  // Calculate the frequency using the period between pulses.

  // Detect if pulses stopped or frequency is too low, so we can show 0 Frequency:
  if (PeriodBetweenPulses > ZeroTimeout - ZeroDebouncingExtra || CurrentMicros - LastTimeCycleMeasure > ZeroTimeout - ZeroDebouncingExtra) {  // If the pulses are too far apart that we reached the timeout for zero :
    FrequencyRaw = 0;                                                                                                                         // Set frequency as 0.
    ZeroDebouncingExtra = 2000;                                                                                                               // Change the threshold a little so it doesn’t bounce.
  } else {
    ZeroDebouncingExtra = 0;  // Reset the threshold to the normal value so it doesn’t bounce.
  }

  FrequencyReal = FrequencyRaw / 10000;  // Get frequency without decimals.

  // Calculate the RPM:
  RPM = FrequencyRaw / PulsesPerRevolution * 60;  // Frequency divided by amount of pulses per revolution multiply by
  // 60 seconds to get minutes.
  RPM = RPM / 10000;  // Remove the decimals.

  // Smoothing RPM:
  total = total - readings[readIndex];  // Advance to the next position in the array.
  readings[readIndex] = RPM;            // Takes the value that we are going to smooth.
  total = total + readings[readIndex];  // Add the reading to the total.
  readIndex = readIndex + 1;            // Advance to the next position in the array.

  if (readIndex >= numReadings)  // If we’re at the end of the array:
  {
    readIndex = 0;  // Reset array index.
  }

  // Calculate the average:
  average = total / numReadings;  // The average value it’s the smoothed result.

  Kmh = (average * 72 * 3.1416 * 60) / 1000000;  // km/h

  // LiDAR//

  if (radio.available()) {
    radio.read(&dist, sizeof(dist));  // Read variable from radio
  } else {
    Stopready = true;
  }

  // Timing loop
  unsigned long currentTime = micros();
  if (currentTime - previousTime1 >= 20000) {

    previousTime1 = currentTime;

    // Distance limit

    dist_m = dist * 0.01;

    if (dist_m >= setpoint + 0.9) {
      dist_m = setpoint + 0.9;
    }
    if (dist_m <= setpoint - 0.9) {
      dist_m = setpoint - 0.9;
    }

    // Moving average with window length 2 for distance

    dist_m_prev = dist_m;

    input = ((dist_m + dist_m_prev) * 0.5) - setpoint;  // Distance error in meters

    // PID//

    // Fit a quadratic curve on input

    double *input_v = cache.step(input);
    double &input0 = *input_v;
    double &input1 = *(input_v + 1);
    double &input2 = *(input_v + 2);
    quad.solve(input2, input1, input0);

    // Derivative

    derivative = quad.deriv() / dt;  // Find derivative from quadratic

    // Low pass filter

    // filter_part = ((0.20657 * derivative) + (0.369527 * part1) + (-0.195816 * part2)) ; //2nd order butterworth lp filter alpha 0.1
    // filter_part = ((0.0674553 * derivative) + (1.14298 * part1) + (-0 .4128016 * part2)) ; //2nd order butterworth lp filter alpha 0.2
    filter_part = ((0.0200833 * derivative) + (1.561018 * part1) + (-0.64135 * part2));  // 2nd order butterworth lp filter alpha 0.05
    // filter_part = ((0.0036217 * derivative) + (1.822695 * part1) + (-0.83718 * part2)) ; //2nd order butterworth lp filter alpha 0.02

    double *part0_v = filter.step(filter_part);
    double &part0 = *part0_v;
    double &part1 = *(part0_v + 1);
    double &part2 = *(part0_v + 2);

    // Rate limiter

    f_deriv = (part0 + part2 + 2 * part1);
    double deriv_rate = (f_deriv - f_deriv_prev);
    if (deriv_rate > rate_limit) {
      y_deriv = f_deriv_prev + rate_limit;
    } else if (deriv_rate < -(1.5 * rate_limit)) {
      y_deriv = f_deriv_prev - (1.5 * rate_limit);
    } else {
      y_deriv = f_deriv;
    }
    f_deriv_prev = y_deriv;

    // Moving average

    double *ma_v = movingaverage.step(y_deriv);
    double &ma0 = *ma_v;
    double &ma1 = *(ma_v + 1);
    double &ma2 = *(ma_v + 2);
    double &ma3 = *(ma_v + 3);
    double &ma4 = *(ma_v + 4);
    double &ma5 = *(ma_v + 5);
    double &ma6 = *(ma_v + 6);
    ma_deriv = (ma0 + ma1 + ma2 + ma3 + ma4 + ma5 + ma6) / 7.0;

    // Accelleration//

    double *acc_v = cache2.step(ma_deriv);
    double &acc0 = *acc_v;
    double &acc1 = *(acc_v + 1);
    double &acc2 = *(acc_v + 2);
    quad2.solve(acc2, acc1, acc0);

    acceleration = quad2.deriv() / dt;

    // Low pass filter

    // filter1_part = ((0.0200833 * acceleration) + (1.561018 * part11) + (-0.64135 * part12)) ; //2nd order butterworth lp filter alpha 0.05
    filter1_part = ((0.0036217 * acceleration) + (1.822695 * part11) + (-0.83718 * part12));  // 2nd order butterworth lp filter alpha 0.02

    double *part10_v = filter2.step(filter1_part);
    double &part10 = *part10_v;
    double &part11 = *(part10_v + 1);
    double &part12 = *(part10_v + 2);

    f_acc = (part10 + part12 + 2 * part11);

    // Dynamic rate limit, NOG AANPASSEN!!!! ma_deriv*(Kd/50)

    if (abs(ma_deriv) > 0.03) {
      previousTime3 = currentTime;
      pastdist = dist_m;
    }
    if (currentTime - previousTime3 <= 210000 || dist_m - pastdist < 0.15) {
      acc_rate_limit = 3 * dt;
    }
    if (currentTime - previousTime3 > 210000) {
      acc_rate_limit = 0.01 * dt;
    }

    double acc_rate = (f_acc - f_acc_prev);
    if (acc_rate > acc_rate_limit) {
      y_acc = f_acc_prev + acc_rate_limit;
    } else if (acc_rate < -acc_rate_limit) {
      y_acc = f_acc_prev - acc_rate_limit;
    } else {
      y_acc = f_acc;
    }
    f_acc_prev = y_acc;

    // Moving average

    double *ma1_v = movingaverage1.step(y_acc);
    double &ma10 = *ma1_v;
    double &ma11 = *(ma1_v + 1);
    double &ma12 = *(ma1_v + 2);
    double &ma13 = *(ma1_v + 3);
    double &ma14 = *(ma1_v + 4);
    double &ma15 = *(ma1_v + 5);
    double &ma16 = *(ma1_v + 6);
    double &ma17 = *(ma1_v + 7);
    double &ma18 = *(ma1_v + 8);
    ma_acc = (ma10 + ma11 + ma12 + ma13 + ma14 + ma15 + ma16 + ma17 + ma18) / 9 .0;

    // Dynamic tuning of PID, High Kp and lower Kd and Ka for accellerating from start, slowing down to full stop and when almost going off the treadmill

    if (abs(input) > 0.33) {

      if (input < -0.33) {
        Kp = 0.4 + (abs(input) - 0.33) * 35;
      }
      if (input > 0.33) {
        Kp = 0.4 + (abs(input) - 0.33) * 23;
      }
      Ka = 400 - (abs(input) - 0.33) * 1200;
      Kd = 80 - (abs(input) - 0.33) * 460;
    }

    else {
      Kp = 0.4;
      Ka = 400;
      Kd = 80;
    }

    proportional = input;

    pid_output = (Kd * ma_deriv + Ka * ma_acc + Kp * proportional);

    // PID output limit

    if (abs(pid_output) >= 3) {
      pid_out2 = 3;
    }
    if (abs(pid_output) < 3) {
      pid_out2 = pid_output;
    }

    V_demand = Kmh + pid_out2;
  }

  // Treadmill send timing loop

  if (currentTime - previousTime2 >= 200000) {

    previousTime2 = currentTime;

    // Start system (starts if treadmill speed is zero, biker speed is foreward and hasnt stopped before startstopinterval)
    if (Kmh < 0.2 && ma_deriv > 0.05 && (currentTime - previousTime5 > (startstopinterval * 1000000) || currentTime < (startstopinterval * 1000000)) && input > -0.5 && input < 0.5 && Startready == true) {
      Serial1.write(start, sizeof(start));
      Serial.print("start");
      previousTime4 = currentTime;
      Startready = false;  // Toggle so system starts only once
      Stopready = true;    // Toggle ready for stop
    }

    // Serial send to treadmill//
    else if (V_demand <= 20 && V_demand >= 3) {
      speednr = round(((V_demand)*10) - 5);

      for (byte i = 0; i < 19; i = i + 1) {
        Serial1.write(setspeed[speednr][i]);
      }
    } else if (V_demand > 20) {
      for (byte i = 0; i < 19; i = i + 1) {
        Serial1.write(setspeed[195][i]);
      }
    }

    // Stop system (stops if speed is slower than minimumspeed and system hasnt started before minimum runtime)

    else if ((V_demand < minimumspeed || input < -0.75) && currentTime - previousTime4 > (minimumruntime * 1000000) && currentTime > (minimumruntime * 1000000) && Stopready == true) {
      for (byte i = 0; i < 19; i = i + 1) {
        Serial1.write(stopcmd, sizeof(stopcmd));
        Startready = true;  // Toggle so system stops only once, otherwise starttimer is off
        Stopready = false;  // Toggle ready for start
        previousTime5 = currentTime;
      }
    }

    // Slow speeds when minimum runtime is not reached yet

    else if (V_demand < minimumspeed && V_demand >= 0.5) {
      speednr = round(((V_demand)*10) - 5);

      for (byte i = 0; i < 19; i = i + 1) {
        Serial1.write(setspeed[speednr][i]);
      }
    }

    else if (V_demand < 0.5) {
      for (byte i = 0; i < 19; i = i + 1) {
        Serial1.write(setspeed[0][i]);
      }
    }

    // Serial monitor//

    // Serial.println(Kmh) ;
    // delay(30) ;
    // Serial.flush() ;

    Serial.print(input);
    Serial.print("\t");
    Serial.print(ma_deriv);
    Serial.print("\t");
    Serial.print(ma_acc);
    Serial.println("\t");

    // Serial.print(Kp * proportional) ;
    // Serial.print("\t") ;
    // Serial.print(Kd * ma_deriv) ;
    // Serial.print("\t") ;
    // Serial.print(Ka * ma_acc) ;
    // Serial.print("\t") ;
    // Serial.println(pid_out2) ;
    // Serial.print("\t") ;

    // Serial.print(Kmh) ;
    // Serial.print("\t") ;
    // Serial.print(V_demand) ;
    // Serial.println("\t") ;
  }
}

// Speed sensor 2//

void Pulse_Event()  // The interrupt runs this to calculate the period between pulses:
{

  PeriodBetweenPulses = micros() - LastTimeWeMeasured;  // Current "micros" minus the old "micros" when the last pulse happens.
  // This will result with the period (microseconds) between both pulses.
  // The way is made, the overflow of the "micros" is not going to cause any issue.

  LastTimeWeMeasured = micros();  // Stores the current micros so the next time we have a pulse we would have something to compare with.

  if (PulseCounter >= AmountOfReadings)  // If counter for amount of readings reach the set limit:
  {
    PeriodAverage = PeriodSum / AmountOfReadings;  // Calculate the final period dividing the sum of all readings by the
    // amount of readings to get the average.
    PulseCounter = 1;                 // Reset the counter to start over. The reset value is 1 because its the minimum setting allowed (1 reading).
    PeriodSum = PeriodBetweenPulses;  // Reset PeriodSum to start a new averaging operation.

    int RemapedAmountOfReadings = map(PeriodBetweenPulses, 40000, 5000, 1, 10);  // Remap the period range to the reading range.

    RemapedAmountOfReadings = constrain(RemapedAmountOfReadings, 1, 10);  // Constrain the value so it doesn’t go below or above the limits.
    AmountOfReadings = RemapedAmountOfReadings;                           // Set amount of readings as the remaped value.
  } else {
    PulseCounter++;                               // Increase the counter for amount of readings by 1.
    PeriodSum = PeriodSum + PeriodBetweenPulses;  // Add the periods so later we can average.
  }

}  // End of Pulse_Event.