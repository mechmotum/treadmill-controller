#include <Arduino.h>
#include <LiquidCrystal.h>

/* Desired funtionality:
  - connect with the treadmill using the serialmonitor Communication pins are 18 (tx) and 19 (rx)
  - get the treadmill to move using serial commands
  - couple commands to buttons on the controller:
    - Start
    - Stop
    - Speed Up
    - Speed Down

*/
const int rs = 8, en = 9, d4 = 4, d5 = 5, d6 = 6, d7 = 7, contrast = 13;
LiquidCrystal lcd(rs, en, d4, d5, d6, d7);

// TODO: Pin Assignments
const int StartButton = 2, StopButton = 3, UpButton = 12, DownButton = 11;
int index = 0;
bool startBl = false;


byte start[] = { 0xAC, 0x01, 0x0B, 0x00, 0x00, 0xE0, 0x26 };
byte stopcmd[] = { 0xAC, 0x01, 0x0C, 0x00, 0x00, 0x51, 0xE7 };
byte getcmd[] = {0xAC, 0x01, 0x0A, 0x00, 0x00, 0xB1, 0xE6};

const byte setspeed[196][19] = {
  { 0xAC, 0x01, 0x09, 0x00, 0x0C, 0x00, 0x00, 0x00, 0x00, 0x05, 0x00, 0x00, 0x00, 0x00, 0x00, 0x00, 0x00, 0x64, 0x44 },
  { 0xAC, 0x01, 0x09, 0x00, 0x0C, 0x00, 0x00, 0x00, 0x00, 0x06, 0x00, 0x00, 0x00, 0x00, 0x00, 0x00, 0x00, 0x24, 0x51 },
  { 0xAC, 0x01, 0x09, 0x00, 0x0C, 0x00, 0x00, 0x00, 0x00, 0x07, 0x00, 0x00, 0x00, 0x00, 0x00, 0x00, 0x00, 0xE5, 0x9D },
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  { 0xAC, 0x01, 0x09, 0x00, 0x0C, 0x00, 0x00, 0x00, 0x00, 0xC8, 0x00, 0x00, 0x00, 0x00, 0x00, 0x00, 0x00, 0xA9, 0x8D },
};

void setup() { // put your setup code here, to run once: 
  pinMode(contrast, OUTPUT); analogWrite(contrast, 120); // Contrast pin from the LCD
  pinMode(StartButton, INPUT_PULLUP);
  pinMode(StopButton, INPUT_PULLUP);
  pinMode(UpButton, INPUT_PULLUP);
  pinMode(DownButton, INPUT_PULLUP);

  lcd.begin(16,2); // Sizes of the lcd
  lcd.print("hello world!");
  Serial.begin(9600); // Start de seriële verbinding op 9600 baud
  Serial1.begin(19200);
}

void loop() {
  if (!digitalRead(StopButton)) { // Stop
    index = 0;
    startBl = false;
    Serial1.write(stopcmd, sizeof(stopcmd));
    Serial.println("Stop"); 
  }
  
  if (!digitalRead(StartButton)) { // Start
    startBl = true;
    Serial1.write(start, sizeof(start));
    Serial.println("Start");
  }

  if (startBl) { // treadmill is running
    bool up = !digitalRead(UpButton);
    bool down = !digitalRead(DownButton);
    if (up && index != 193)  { // Speed Up
      index += 1;
      Serial1.write(setspeed[index], sizeof(setspeed[index]));
      Serial.println(index);
    }
    if (down && index != 0)  { // Speed Down
      index -= 1;
      Serial1.write(setspeed[index], sizeof(setspeed[index]));
      Serial.println(index);
    }
  }

  // print to screen
  lcd.clear();
  lcd.setCursor(0,0);
  lcd.print(startBl? "Start" : "Stop");
  lcd.setCursor(0,1);
  lcd.print("Speed: ");
  lcd.print(index);
  delay(100);
}


