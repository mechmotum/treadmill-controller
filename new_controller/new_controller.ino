/*
  Treadmill Controller with Manual Button Controls
  Based on the original bep_code.ino

  Features:
  - Start/Stop buttons
  - Speed increase/decrease buttons (0.1 km/h increments)
  - Serial communication with treadmill
  - Speed range: 0.5 - 20.0 km/h
  - LCD display showing current status

  Button connections:
  - Pin 3: Start button (with pull-up resistor)
  - Pin 4: Stop button (with pull-up resistor)
  - Pin 5: Speed Up button (with pull-up resistor)
  - Pin 6: Speed Down button (with pull-up resistor)

  LCD connections (16x2):
  - VSS to ground
  - VDD to 5V
  - V0 to potentiometer (contrast)
  - RS to digital pin 12
  - Enable to digital pin 11
  - D4 to digital pin 10
  - D5 to digital pin 9
  - D6 to digital pin 8
  - D7 to digital pin 7
  - A to 5V (backlight)
  - K to ground (backlight)
*/

#include <Arduino.h>
#include <LiquidCrystal.h>

// Treadmill control commands (copied from original code)
byte start[] = {0xAC, 0x01, 0x0B, 0x00, 0x00, 0xE0, 0x26};
byte stopcmd[] = {0xAC, 0x01, 0x0C, 0x00, 0x00, 0x51, 0xE7};

// Speed commands array (0.5 km/h to 20.0 km/h in 0.1 km/h increments)
byte setspeed[196][19] = {
    {0xAC, 0x01, 0x09, 0x00, 0x0C, 0x00, 0x00, 0x00, 0x00, 0x05, 0x00, 0x00, 0x00, 0x00, 0x00, 0x00, 0x00, 0x64, 0x44}, // 0.5 km/h
    {0xAC, 0x01, 0x09, 0x00, 0x0C, 0x00, 0x00, 0x00, 0x00, 0x06, 0x00, 0x00, 0x00, 0x00, 0x00, 0x00, 0x00, 0x24, 0x51}, // 0.6 km/h
    {0xAC, 0x01, 0x09, 0x00, 0x0C, 0x00, 0x00, 0x00, 0x00, 0x07, 0x00, 0x00, 0x00, 0x00, 0x00, 0x00, 0x00, 0xE5, 0x9D}, // 0.7 km/h
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    {0xAC, 0x01, 0x09, 0x00, 0x0C, 0x00, 0x00, 0x00, 0x00, 0xC8, 0x00, 0x00, 0x00, 0x00, 0x00, 0x00, 0x00, 0xA9, 0x8D}  // 20.0 km/h (index 195)
};

// Initialize LCD display (RS, Enable, D4, D5, D6, D7)
LiquidCrystal lcd(12, 11, 10, 9, 8, 7);

// Pin definitions
const int START_BUTTON_PIN = 3;
const int STOP_BUTTON_PIN = 4;
const int SPEED_UP_BUTTON_PIN = 5;
const int SPEED_DOWN_BUTTON_PIN = 6;

// Variables
float currentSpeed = 0.0; // Current speed in km/h
bool treadmillRunning = false;
unsigned long lastButtonPress = 0;
const unsigned long BUTTON_DEBOUNCE_DELAY = 200; // 200ms debounce

// Button state tracking for edge detection
bool lastStartButtonState = HIGH;
bool lastStopButtonState = HIGH;
bool lastSpeedUpButtonState = HIGH;
bool lastSpeedDownButtonState = HIGH;

void setup()
{
  // Initialize serial communication with treadmill
  Serial1.begin(19200);

  // Initialize serial monitor for debugging
  Serial.begin(115200);

  // Initialize LCD display
  lcd.begin(16, 2);
  lcd.clear();

  // Configure button pins with internal pull-up resistors
  pinMode(START_BUTTON_PIN, INPUT_PULLUP);
  pinMode(STOP_BUTTON_PIN, INPUT_PULLUP);
  pinMode(SPEED_UP_BUTTON_PIN, INPUT_PULLUP);
  pinMode(SPEED_DOWN_BUTTON_PIN, INPUT_PULLUP);

  // Display startup message
  lcd.setCursor(0, 0);
  lcd.print("Treadmill Ctrl");
  lcd.setCursor(0, 1);
  lcd.print("Ready - STOPPED");

  Serial.println("Treadmill Controller Ready");
  Serial.println("Controls:");
  Serial.println("- Pin 3: Start");
  Serial.println("- Pin 4: Stop");
  Serial.println("- Pin 5: Speed Up (+0.1 km/h)");
  Serial.println("- Pin 6: Speed Down (-0.1 km/h)");
  Serial.println("Speed range: 0.5 - 20.0 km/h");
}

void loop()
{
  // Read button states
  bool startButtonState = digitalRead(START_BUTTON_PIN);
  bool stopButtonState = digitalRead(STOP_BUTTON_PIN);
  bool speedUpButtonState = digitalRead(SPEED_UP_BUTTON_PIN);
  bool speedDownButtonState = digitalRead(SPEED_DOWN_BUTTON_PIN);

  unsigned long currentTime = millis();

  // Check for button presses with debouncing and edge detection
  if (currentTime - lastButtonPress > BUTTON_DEBOUNCE_DELAY)
  {

    // Start button pressed (falling edge)
    if (lastStartButtonState == HIGH && startButtonState == LOW)
    {
      startTreadmill();
      lastButtonPress = currentTime;
    }

    // Stop button pressed (falling edge)
    if (lastStopButtonState == HIGH && stopButtonState == LOW)
    {
      stopTreadmill();
      lastButtonPress = currentTime;
    }

    // Speed up button pressed (falling edge)
    if (lastSpeedUpButtonState == HIGH && speedUpButtonState == LOW)
    {
      increaseSpeed();
      lastButtonPress = currentTime;
    }

    // Speed down button pressed (falling edge)
    if (lastSpeedDownButtonState == HIGH && speedDownButtonState == LOW)
    {
      decreaseSpeed();
      lastButtonPress = currentTime;
    }
  }

  // Update button states for next iteration
  lastStartButtonState = startButtonState;
  lastStopButtonState = stopButtonState;
  lastSpeedUpButtonState = speedUpButtonState;
  lastSpeedDownButtonState = speedDownButtonState;

  // Small delay to prevent excessive CPU usage
  delay(10);
}

void startTreadmill()
{
  if (!treadmillRunning)
  {
    Serial1.write(start, sizeof(start));
    treadmillRunning = true;
    currentSpeed = 0.5; // Start at minimum speed

    Serial.println("Treadmill STARTED");
    Serial.print("Speed: ");
    Serial.print(currentSpeed, 1);
    Serial.println(" km/h");

    // Send initial speed command
    setSpeed(currentSpeed);

    // Update LCD display
    updateDisplay();
  }
}

void stopTreadmill()
{
  if (treadmillRunning)
  {
    Serial1.write(stopcmd, sizeof(stopcmd));
    treadmillRunning = false;
    currentSpeed = 0.0;

    Serial.println("Treadmill STOPPED");

    // Update LCD display
    updateDisplay();
  }
}

void increaseSpeed()
{
  if (treadmillRunning && currentSpeed < 20.0)
  {
    currentSpeed += 0.1;
    if (currentSpeed > 20.0)
    {
      currentSpeed = 20.0;
    }

    setSpeed(currentSpeed);
    updateDisplay(); // Update LCD display

    Serial.print("Speed increased to: ");
    Serial.print(currentSpeed, 1);
    Serial.println(" km/h");
  }
  else if (!treadmillRunning)
  {
    Serial.println("Cannot change speed - treadmill is stopped");
  }
  else
  {
    Serial.println("Maximum speed reached (20.0 km/h)");
  }
}

void decreaseSpeed()
{
  if (treadmillRunning && currentSpeed > 0.5)
  {
    currentSpeed -= 0.1;
    if (currentSpeed < 0.5)
    {
      currentSpeed = 0.5;
    }

    setSpeed(currentSpeed);
    updateDisplay(); // Update LCD display

    Serial.print("Speed decreased to: ");
    Serial.print(currentSpeed, 1);
    Serial.println(" km/h");
  }
  else if (!treadmillRunning)
  {
    Serial.println("Cannot change speed - treadmill is stopped");
  }
  else
  {
    Serial.println("Minimum speed reached (0.5 km/h)");
  }
}

void setSpeed(float speed)
{
  // Convert speed to array index
  // Speed range: 0.5 to 20.0 km/h in 0.1 km/h increments
  // Array index = (speed * 10) - 5
  int speedIndex = round((speed * 10) - 5);

  // Constrain to valid range
  speedIndex = constrain(speedIndex, 0, 195);

  // Send speed command to treadmill
  for (byte i = 0; i < 19; i++)
  {
    Serial1.write(setspeed[speedIndex][i]);
  }
}

void updateDisplay()
{
  lcd.clear();

  // First line: Status
  lcd.setCursor(0, 0);
  if (treadmillRunning)
  {
    lcd.print("Status: RUNNING");
  }
  else
  {
    lcd.print("Status: STOPPED");
  }

  // Second line: Speed
  lcd.setCursor(0, 1);
  lcd.print("Speed: ");
  if (treadmillRunning)
  {
    lcd.print(currentSpeed, 1);
    lcd.print(" km/h");
  }
  else
  {
    lcd.print("0.0 km/h");
  }
}
